## firmware/edu-riscv64/access_control/Kconfig
```kconfig
menuconfig APP_ACCESS_CONTROL
    bool "Enable smart access LED demo"
    depends on ADD_XIZI_FEATURES && BOARD_EDU_RISCV64_EVB && !SEPARATE_COMPILE
    select BSP_USING_GPIO
    select RESOURCES_PIN
    select TOOL_SHELL
    default n
    help
        Simulate a door lock using IO29. Disable USER_TEST_GPIO first.
        Commands: Door ping/status/allow/deny [12-character hex ID].
```

## firmware/edu-riscv64/access_face/Kconfig
```kconfig
menuconfig APP_ACCESS_FACE
    bool "Smart access board-camera feature demo"
    depends on BOARD_EDU_RISCV64_EVB && ADD_XIZI_FEATURES
    depends on !SEPARATE_COMPILE
    select APP_ACCESS_CONTROL
    select BSP_USING_CAMERA
    select BSP_USING_LCD
    select BSP_USING_DMA
    select BSP_USING_KPU
    select DVP_INTERRUPT_ENABLE
    default n
```
